## components/eapol_logger/Kconfig
```kconfig
menu "Eapol Logger Config"

    config EAPOL_LOGGER_WAIT_MS
        int "Max wat in ms for the lock"
        default 10

endmenu
```

## components/mac_logger/Kconfig
```kconfig
menu "MAC LOGGER CONFIG"
    config MAC_LOGGER_MAX_STAS
        int "Maximum number of STA in the MAC logger list"
        range 1 32
        default 16
    
    config MAC_LOGGER_MAX_APS
        int "Maximum number of AP in the MAC logger list"
        range 1 16
        default 8

    config MAC_LOGGER_WAIT_MS
        int "Time to wait in MS for lock"
        default 10

    config MAC_LOGGER_Q_SIZE
        int "Number of packets allowed on in queue"
        default 16

    config MAC_LOGGER_STACK_SIZE
        int "Mac logger task stack size"
        default 4096

    config MAC_LOGGER_CONSUMER_PRIO
        int "Mac logger task prio"
        default 10
        
endmenu
```

## components/pkt_sniffer/Kconfig
```kconfig
menu "PKT Sniffer Config"

    config PKT_MAX_FILTERS
        int "Max number of Pkt Sniffer Filtered CBs"
        default 4
    
endmenu
```

## components/repl_mux/Kconfig
```kconfig
menu "REPL MUX Config"

    config REPL_MUX_N_QUEUES
        int "Number of mux queues"
        default 2
    
    config REPL_MUX_MAX_LOG_MSG
        int "Max size of a log message and input message"
        default 128

    config REPL_MUX_Q_SIZE
        int "Number of messages allowed on the each Q at a given time"
        default 8

    config REPL_MUX_STACK_SIZE
        int "Consumer Task stack size"
        default 4096

    config REPL_MUX_CONSUMER_PRIO
        int "Consumer Task Priority"
        default 2

    config REPL_MUX_WAIT_MS
        int "Time in ms to wait for queue to clear up to publish more logs"
        default 10

    config REPL_MUX_IP
        string "IP of repl server"
        default "192.168.4.1"
    
    config REPL_MUX_PORT
        int "Port of repl server"
        default 421

    config REPL_MUX_MAX_NUM_CMD
        int "Number of commands that can be regstered in the command table"
        default 32

    config REPL_MUX_MAX_CMD_ARG
        int "Max number of args a commmand can have"
        default 6

    config REPL_MUX_NAME_LEN
        int "Length of a command name string"
        default 32

    config REPL_MUX_DESC_LEN
        int "Length of a command name string"
        default 64

endmenu
```

## esp32_build/components/HD44780/Kconfig
```kconfig
menu "HD44780 LCD Configuration"
    config LCD_I2C_SPEED
        int "i2c speed"
        range 1000 100000
        default 50000
        help
            The speed of the i2c bus managing the LCD

    config LCD_SDA_PIN
        int "LCD SDA Pin"
        range 1 100
        default 25
        help
            GPIO Pin for which the i2c LCD SDA pin is connected

    config LCD_SCL_PIN
        int "LCD SCL Pin"
        range 1 100
        default 26
        help
            GPIO Pin for which the i2c LCD SCL pin is connected

    config LCD_I2C_ADDR
        int "LCD i2c addr"
        range 1 100
        default 39
        help
            The I2C addr of the LCD's i2c io expander

    config LCD_COLS
        int "Number of columns on the LCD"
        range 10 40
        default 20
        help
            Number of columns on the LCD

    config LCD_ROWS
        int "Number of row on the LCD"
        range 1 10
        default 4
        help
            Number of row on the LCD
endmenu
```

## esp32_build/components/mac_logger/Kconfig
```kconfig
menu "MAC LOGGER CONFIG"
    config MAC_LOGGER_MAX_STAS
        int "Maximum number of STA in the MAC logger list"
        range 1 1024
        default 256
    
    config MAC_LOGGER_MAX_APS
        int "Maximum number of AP in the MAC logger list"
        range 1 128
        default 32

    config MAC_LOGGER_WAIT_MS
        int "Time to wait in MS for lock"
        default 1

endmenu
```

## esp32_build/components/tcp_file_server/Kconfig
```kconfig
menu "TCP File Server Config"

    config TCP_SERVER_IP
        string "IP for listening socket to bind to"
        default "192.168.4.1"

    config TCP_SERVER_PORT
        int "Port for listening socekt to bind to"
        default 420

    config TCP_SERVER_PRIO
        int "Priority of TCP Server Task"
        default 5

endmenu 
```

## esp32_build/components/user_interface/Kconfig
```kconfig
menu "UI Config"

    config UI_NUM_CMDS
        int "UI Max number of commands"
        range 4 64
        default 16
        help
            Max number of ui commands


    config UI_NUM_LINE_BUFF
        int "UI Max number of line buffer lines"
        range 32 256
        default 64
        help
            Max number of line buffer lines

    config UI_EVENT_Q_SIZE
        int "UI Event Queue Size"
        range 2 32
        default 8
        help
            Event Q Size

    config UI_EVENT_HNDLR_PRIO
        int "UI Event handler task Prio"
        range 1 20
        default 10
        help
            Event Handler task priority

endmenu
```

## main/Kconfig.projbuild
```kconfig
menu "Global ESP 32 Deluminator Config"

    config SPIFFS_MOUNT_PATH
        string "Mount Path for SPIFFS"
        default "/spiffs"

    config SPIFFS_MAX_FILES
        int "max files on FS"
        default 32
endmenu
```
